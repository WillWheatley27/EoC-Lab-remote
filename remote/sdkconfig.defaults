## remote/sdkconfig.defaults
```kconfig
# ESP32-C3 target.
CONFIG_IDF_TARGET="esp32c3"

# BLE: NimBLE (no Bluedroid). Match the main board's config style.
CONFIG_BT_ENABLED=y
CONFIG_BT_CONTROLLER_ENABLED=y
# CONFIG_BT_BLUEDROID_ENABLED is not set
CONFIG_BT_NIMBLE_ENABLED=y
CONFIG_NIMBLE_ENABLED=y

# We only advertise. Roles are left at NimBLE defaults to avoid Kconfig
# dependency surprises; the unused role code is dead but harmless.

# Use the USB-Serial-JTAG console for `idf.py monitor`.
CONFIG_ESP_CONSOLE_USB_SERIAL_JTAG=y
```
